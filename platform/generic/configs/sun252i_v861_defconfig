## platform/generic/configs/sun252i_v861_defconfig
```kconfig
CONFIG_PLATFORM_ALLWINNER_V861=y
CONFIG_FDT_IPI=y
CONFIG_FDT_IPI_MSWI=y
CONFIG_FDT_IPI_PLICSW=y
CONFIG_FDT_IRQCHIP=y
CONFIG_FDT_IRQCHIP_PLIC=y
CONFIG_FDT_RESET=y
CONFIG_FDT_SERIAL=y
CONFIG_FDT_SERIAL_SUNXI=y
CONFIG_FDT_TIMER=y
CONFIG_FDT_TIMER_MTIMER=y
```

## platform/generic/thead/Kconfig
```kconfig
# SPDX-License-Identifier: BSD-2-Clause

config THEAD_C9XX_PMU
	bool "T-HEAD c9xx M-mode PMU support"
	default n

config THEAD_C9XX_ERRATA
	bool "T-HEAD c9xx errata support"
	default n

config THEAD_C9XX_SMP
	bool "T-HEAD c9xx SMP support"
	default n

config THEAD_64ILP32_ENHANCE
	bool "T-HEAD enhancement for 64ilp32"
	default n
```
